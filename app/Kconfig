## app/Kconfig
```kconfig
#
# For a description of the syntax of this configuration file,
# see the file kconfig-language.txt in the NuttX tools repository.
#

config CUSTOM_APP
	tristate "Custom application"
	default n
	---help---
		Enable the Custom application

if CUSTOM_APP

config CUSTOM_APP_PROGNAME
	string "Program name"
	default "custom_app"
	---help---
		This is the name of the program that will be used when the NSH ELF
		program is installed.

config CUSTOM_APP_PRIORITY
	int "Custom app task priority"
	default 100

config CUSTOM_APP_STACKSIZE
	int "Custom app stack size"
	default DEFAULT_TASK_STACKSIZE

endif 
```
